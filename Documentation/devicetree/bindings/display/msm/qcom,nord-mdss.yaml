## Documentation/devicetree/bindings/display/msm/qcom,nord-mdss.yaml
```yaml
# SPDX-License-Identifier: GPL-2.0-only OR BSD-2-Clause
%YAML 1.2
---
$id: http://devicetree.org/schemas/display/msm/qcom,nord-mdss.yaml#
$schema: http://devicetree.org/meta-schemas/core.yaml#

title: Qualcomm Nord Display MDSS

maintainers:
  - Mahadevan P <mahap@qti.qualcomm.com>

description:
  Nord MSM Mobile Display Subsystem(MDSS), which encapsulates sub-blocks like
  DPU display controller and DP interfaces, etc.

$ref: /schemas/display/msm/mdss-common.yaml#

properties:
  compatible:
    const: qcom,nord-mdss

  clocks:
    items:
      - description: Display AHB
      - description: Display hf AXI
      - description: Display core

  iommus:
    maxItems: 1

  interconnects:
    items:
      - description: Interconnect path from mdp0 port to the data bus
      - description: Interconnect path from CPU to the reg bus

  interconnect-names:
    items:
      - const: mdp0-mem
      - const: cpu-cfg

patternProperties:
  "^display-controller@[0-9a-f]+$":
    type: object
    additionalProperties: true
    properties:
      compatible:
        const: qcom,nord-dpu

  "^displayport-controller@[0-9a-f]+$":
    type: object
    additionalProperties: true
    properties:
      compatible:
        const: qcom,nord-dp

  "^phy@[0-9a-f]+$":
    type: object
    additionalProperties: true
    properties:
      compatible:
        const: qcom,nord-dp-phy

required:
  - compatible

unevaluatedProperties: false

examples:
  - |
    #include <dt-bindings/clock/qcom,rpmh.h>
    #include <dt-bindings/interconnect/qcom,icc.h>
    #include <dt-bindings/interconnect/qcom,nord-rpmh.h>
    #include <dt-bindings/interrupt-controller/arm-gic.h>
    #include <dt-bindings/power/qcom,rpmhpd.h>

    display-subsystem@ae00000 {
            compatible = "qcom,nord-mdss";
            reg = <0x0ae00000 0x1000>;
            reg-names = "mdss";

            interrupts = <GIC_SPI 83 IRQ_TYPE_LEVEL_HIGH>;

            clocks = <&dispcc_ahb_clk>,
                     <&gcc_disp_hf_axi_clk>,
                     <&dispcc_mdp_clk>;
            clock-names = "bus", "nrt_bus", "core";

            interconnects = <&mmss_noc MASTER_MDP QCOM_ICC_TAG_ALWAYS
                             &mc_virt SLAVE_EBI1 QCOM_ICC_TAG_ALWAYS>,
                            <&gem_noc MASTER_APPSS_PROC QCOM_ICC_TAG_ACTIVE_ONLY
                             &config_noc SLAVE_DISPLAY_CFG QCOM_ICC_TAG_ACTIVE_ONLY>;
            interconnect-names = "mdp0-mem",
                                 "cpu-cfg";

            resets = <&disp_cc_mdss_core_bcr>;

            power-domains = <&mdss_gdsc>;

            iommus = <&apps_smmu 0x800 0x2>;

            interrupt-controller;
            #interrupt-cells = <1>;

            #address-cells = <1>;
            #size-cells = <1>;
            ranges;

            display-controller@ae35000 {
                compatible = "qcom,nord-dpu";
                reg = <0x0ae01000 0x93000>,
                      <0x0aeb0000 0x3000>;
                reg-names = "mdp", "vbif";

                clocks = <&gcc_disp_hf_axi_clk>,
                         <&dispcc_ahb_clk>,
                         <&dispcc_mdp_lut_clk>,
                         <&dispcc_mdp_clk>,
                         <&dispcc_mdp_vsync_clk>;
                clock-names = "nrt_bus",
                              "iface",
                              "lut",
                              "core",
                              "vsync";

                assigned-clocks = <&dispcc_mdp_vsync_clk>;
                assigned-clock-rates = <19200000>;

                operating-points-v2 = <&mdp_opp_table>;
                power-domains = <&rpmhpd RPMHPD_MMCX>;

                interrupt-parent = <&mdss>;
                interrupts = <0>;

                ports {
                    #address-cells = <1>;
                    #size-cells = <0>;

                    port@0 {
                        reg = <0>;
                        dpu_intf0_out: endpoint {
                            remote-endpoint = <&mdss_dp0_in>;
                        };
                    };

                    port@1 {
                        reg = <1>;
                        dpu_intf4_out: endpoint {
                            remote-endpoint = <&mdss_dp1_in>;
                        };
                    };
                };

                mdp_opp_table: opp-table {
                    compatible = "operating-points-v2";

                    opp-200000000 {
                        opp-hz = /bits/ 64 <200000000>;
                        required-opps = <&rpmhpd_opp_low_svs>;
                    };

                    opp-325000000 {
                        opp-hz = /bits/ 64 <325000000>;
                        required-opps = <&rpmhpd_opp_svs>;
                    };
                };
            };

            displayport-controller@af54000 {
                compatible = "qcom,nord-dp";
                reg = <0x0af54000 0x200>,
                      <0x0af54200 0x200>,
                      <0x0af55000 0xc00>,
                      <0x0af56000 0x400>,
                      <0x0af57000 0x400>;

                interrupt-parent = <&mdss>;
                interrupts = <12>;

                clocks = <&dispcc_ahb_clk>,
                         <&dispcc_dptx0_aux_clk>,
                         <&dispcc_dptx0_link_clk>,
                         <&dispcc_dptx0_link_intf_clk>,
                         <&dispcc_dptx0_pixel0_clk>;
                clock-names = "core_iface",
                              "core_aux",
                              "ctrl_link",
                              "ctrl_link_iface",
                              "stream_pixel";

                power-domains = <&rpmhpd RPMHPD_MMCX>;

                phys = <&dp0_phy>;
                phy-names = "dp";

                #sound-dai-cells = <0>;

                ports {
                    #address-cells = <1>;
                    #size-cells = <0>;

                    port@0 {
                        reg = <0>;

                        mdss_dp0_in: endpoint {
                            remote-endpoint = <&dpu_intf0_out>;
                        };
                    };

                    port@1 {
                        reg = <1>;

                        mdss_dp0_out: endpoint {
                        };
                    };
                };
            };
        };
...
```
